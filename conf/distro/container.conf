## conf/distro/container.conf
```bitbake
require conf/distro/poky.conf 
DISTRO = "container" 
DISTRO_NAME = "container" 
DISTRO_VERSION = "1.0-${DATE}" 
DISTRO_CODENAME = "master" 
SDK_VENDOR = "-containersdk" 
MAINTAINER = "Ralf Anton Beier <ralf_beier@me.com>" 
TARGET_VENDOR = "-container" 
TCLIBC = "musl" 
DISTRO_FEATURES = "acl ipv4 ipv6 largefile xattr ${DISTRO_FEATURES_LIBC}" 
PREFERRED_PROVIDER_virtual/kernel ?= "linux-dummy"
VIRTUAL-RUNTIME_dev_manager ?= "" 
VIRTUAL-RUNTIME_login_manager ?= "" 
VIRTUAL-RUNTIME_init_manager ?= "" 
VIRTUAL-RUNTIME_initscripts ?= "" 
VIRTUAL-RUNTIME_keymaps ?= "" 

PREFERRED_VERSION_ostree ?= "2021.3"
```

## conf/layer.conf
```bitbake
# We have a conf and classes directory, add to BBPATH
BBPATH .= ":${LAYERDIR}"

# We have recipes-* directories, add to BBFILES
BBFILES += "${LAYERDIR}/recipes-*/*/*.bb ${LAYERDIR}/recipes-*/*/*.bbappend"

BBFILE_COLLECTIONS += "fmu"
BBFILE_PATTERN_fmu = "^${LAYERDIR}/"
BBFILE_PRIORITY_fmu = "1"

# This should only be incremented on significant changes that will
# cause compatibility issues with other layers
LAYERVERSION_fmu = "1"

LAYERDEPENDS_fmu = "core"

LAYERSERIES_COMPAT_fmu = " langdale "
```
